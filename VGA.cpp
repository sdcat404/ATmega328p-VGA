#include <avr/pgmspace.h>
#if defined(ARDUINO) && ARDUINO >= 100
  #include "Arduino.h"
#else
  #include "WProgram.h"
#endif

#include <stdlib.h>
#include <Adafruit_GFX.h>
#include "VGA.h"

const byte VSYNCPIN = 10;
const byte HSYNCPIN = 3 ;
const byte DATAPIN  = 7 ;
static uint16_t line = 0;
volatile uint32_t tmr = 0;
static byte aline, rlinecnt;

// the memory buffer for the LCD
static uint8_t vga_buffer[VGAWIDTH * VGAHEIGHT / 8] = {
0x00, 0x00, 0x00, 0x00, 0x00, 0x00, 0x00, 0x00, 0x00, 0x00, 0x00, 0x00, 0x00, 0x00, 0x00, 0x00, 0x00, 0x00, 0x00, 0x00,
0x00, 0x00, 0x00, 0x00, 0x00, 0x00, 0x00, 0x00, 0x00, 0x00, 0x00, 0x00, 0x00, 0x00, 0x00, 0x00, 0x00, 0x00, 0x00, 0x00,
0x00, 0x00, 0x00, 0x00, 0x00, 0x00, 0x00, 0x00, 0x00, 0x00, 0x00, 0x00, 0x00, 0x00, 0x00, 0x00, 0x00, 0x00, 0x00, 0x00,
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0x00, 0x00, 0x00, 0x00, 0x00, 0x00, 0x00, 0x00, 0x00, 0x00, 0x00, 0x00, 0x00, 0x00, 0x00, 0x00, 0x00, 0x00, 0x00, 0x00
#if (VGAHEIGHT == 80)
,
0x00, 0x00, 0x00, 0x00, 0x00, 0x00, 0x00, 0x00, 0x00, 0x00, 0x00, 0x00, 0x00, 0x00, 0x00, 0x00, 0x00, 0x00, 0x00, 0x00,
0x00, 0x00, 0x00, 0x00, 0x00, 0x00, 0x00, 0x00, 0x00, 0x00, 0x00, 0x00, 0x00, 0x00, 0x00, 0x00, 0x00, 0x00, 0x00, 0x00,
0x00, 0x00, 0x00, 0x00, 0x00, 0x00, 0x00, 0x00, 0x00, 0x00, 0x00, 0x00, 0x00, 0x00, 0x00, 0x00, 0x00, 0x00, 0x00, 0x00,
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0x00, 0x00, 0x00, 0x00, 0x00, 0x00, 0x00, 0x00, 0x00, 0x00, 0x00, 0x00, 0x00, 0x00, 0x00, 0x00, 0x00, 0x00, 0x00, 0x00
#endif
};


VGA::VGA() : Adafruit_GFX(VGAWIDTH, VGAHEIGHT) {

}

void VGA::drawPixel(int16_t x, int16_t y, uint16_t color) {
	if ((x < 0) || (x >= VGAWIDTH) || (y < 0) || (y >= VGAHEIGHT))
      return;
    int16_t t;
  switch(rotation){
    case 1:
      t = x;
      x = y;
      y =  VGAHEIGHT - 1 - t;
      break;
    case 2:
      x = VGAWIDTH - 1 - x;
      y = VGAHEIGHT - 1 - y;
      break;
    case 3:
      t = x;
      x = VGAWIDTH - 1 - y;
      y = t;
      break;
  }

  if ((x < 0) || (x >= VGAWIDTH) || (y < 0) || (y >= VGAHEIGHT))
    return;
	
	switch (color)
    {
      case 0:   vga_buffer[y * 20 + (x/8)] &= ~( 1 << (7-(x&7)) ); break;
      case 1:   vga_buffer[y * 20 + (x/8)] |=  ( 1 << (7-(x&7)) ); break;
      case 2:   vga_buffer[y * 20 + (x/8)] ^=  ( 1 << (7-(x&7)) );
    }
}


void VGA::begin() {
  pinMode(DATAPIN, OUTPUT);
  // disable TIMER0 interrupt
  TIMSK0 = 0;
  TCCR0A = 0;
  TCCR0B=(1 << CS00);
  OCR0A  = 0;
  OCR0B  = 0;
  TCNT0  = 0;

  pinMode(VSYNCPIN, OUTPUT);

  // TIMER2 - horizontal sync pulses
  pinMode(HSYNCPIN, OUTPUT);
  TCCR2A = bit(WGM20) | bit(WGM21) | bit(COM2B1); //pin3=COM2B1
  TCCR2B = bit(WGM22) | bit(CS21); //8 prescaler
  OCR2A  = 63;          // 32 / 0.5 uS=64 (minus one)
  OCR2B  = 7;           // 4 / 0.5 uS=8 (minus one)
  TIFR2  = bit(OCF2B);  // clear Compare Match B flag
  TIMSK2 = bit(OCIE2B); // enable Compare Match B interrupt
  
  sei();
}

// HSYNC interrupt
ISR(TIMER2_COMPB_vect) {  // Timer2 COMPB ISR
  line++;
  // VSYNC signal
  if(line > 522) {
    PORTB &= 0xFB;
    if(line > 524) {
      PORTB |= 0x04;
      aline    = 0;
      line     = 0;
      rlinecnt = 0;
    }
    tmr++;
    return;
  }
  if (line < STARTLINE || line > ENDLINE - 1) {
    tmr++;
    return;
  }

  asm volatile (
      ".rept 20             \n\t"  // output 8 pixels for each iteration
      "    ld r16, Z+       \n\t"  //
      "    out %[port], r16 \n\t"  // write pixel 1
      "    lsl r16     \n\t"
      "    out %[port], r16  \n\t" // write pixel 2
      "    lsl r16     \n\t"
      "    out %[port], r16  \n\t" // write pixel 3
      "    lsl r16     \n\t"
      "    out %[port], r16  \n\t" // write pixel 4
      "    lsl r16     \n\t"
      "    out %[port], r16  \n\t" // write pixel 5
      "    lsl r16     \n\t"
      "    out %[port], r16  \n\t" // write pixel 6
      "    lsl r16     \n\t"
      "    out %[port], r16  \n\t" // write pixel 7
      "    lsl r16     \n\t"
      "    out %[port], r16  \n\t" // write pixel 8
      ".endr                \n\t"  //
      "    lsl r16     \n\t"
      "    out %[port], r16 \n\t"  // write black for next pixels
    :
    : [port] "I" (_SFR_IO_ADDR(PORTD)),
      "z" "I" ( (byte*)vga_buffer + rlinecnt * VGA_BWIDTH )
    : "r16", "memory");

    aline++;
    if (aline == CLONED_LINES) {
      aline = 0;
      rlinecnt++;
    }
    if(line == ENDLINE - 1)
      aline = 0;
    tmr++;
}

// clear everything
void VGA::clearDisplay(void) {
  memset(vga_buffer, 0, VGAWIDTH*VGAHEIGHT/8);
  cursor_y = cursor_x = 0;
}

void VGA::delay(uint16_t msec) {
  tmr = 0;
  uint32_t ticks = (uint32_t)msec*1000/32;
  while(tmr < ticks) ;
}
